## components/jk_bms/Kconfig
```kconfig
menu "JK BMS"

    config JK_BMS_NAME_PREFIX
        string "BMS device name prefix"
        default "Accu"
        help
            Only BLE devices whose advertised name starts with this text are
            treated as batteries. Set the names in the JK BMS app.

    config JK_BMS_BLE_DEVICE_NAME
        string "Own BLE device name"
        default "BatMon"

endmenu
```

## sdkconfig.defaults
```kconfig
# Board: lcdwiki ES3C28P (ESP32-S3 N16R8)
CONFIG_IDF_TARGET="esp32s3"

# Flash: 16 MB quad SPI
CONFIG_ESPTOOLPY_FLASHMODE_QIO=y
CONFIG_ESPTOOLPY_FLASHFREQ_80M=y
CONFIG_ESPTOOLPY_FLASHSIZE_16MB=y
CONFIG_PARTITION_TABLE_CUSTOM=y
CONFIG_PARTITION_TABLE_CUSTOM_FILENAME="partitions.csv"

# PSRAM: 8 MB octal
CONFIG_SPIRAM=y
CONFIG_SPIRAM_MODE_OCT=y
CONFIG_SPIRAM_SPEED_80M=y

# CPU / RTOS
CONFIG_ESP_DEFAULT_CPU_FREQ_MHZ_240=y
CONFIG_FREERTOS_HZ=1000

# Console on the built-in USB-Serial/JTAG (/dev/ttyACM0)
CONFIG_ESP_CONSOLE_USB_SERIAL_JTAG=y

# LVGL
CONFIG_LV_COLOR_DEPTH_16=y
CONFIG_LV_FONT_MONTSERRAT_14=y
CONFIG_LV_FONT_MONTSERRAT_24=y
CONFIG_LV_FONT_MONTSERRAT_36=y
CONFIG_LV_FONT_MONTSERRAT_40=y

# Bluetooth: NimBLE host, central role (JK BMS client)
CONFIG_BT_ENABLED=y
CONFIG_BT_NIMBLE_ENABLED=y
CONFIG_BT_NIMBLE_LOG_LEVEL_WARNING=y
```
